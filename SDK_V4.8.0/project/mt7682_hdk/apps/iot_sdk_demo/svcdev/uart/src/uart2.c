/****************************************************************
	Copyright(C), 1999-2004 Raisecom, Inc.
	filename: uart2.c，串口0驱动函数文件
	Author	: qiaoqiangguo
	version	: 1.0
	date	: 2008/6/21
	Others	:
        THIS DOCUMENT IS GENERATED BY TORNADO TOOLS refgen.exe
        EXAMPLE:
        ->torVars.bat
        ->refgen -mg -out doc uart2.c
        ->cd doc
        ->htmllink
*****************************************************************/
#include "otpconfig.h"

#ifdef INCLUDE_UART2 

#include "string.h"
#include "macro_common.h"
#include "stm32f10x.h"
#include "misc.h"
#include "uart.h"
#include "uart2.h"
#include "ibc.h"

OTP_UINT8	g_uart2_rcv_buf[UART2_RCV_BUFLEN];
OTP_UINT8	g_uart2_send_buf[UART2_SEND_BUFLEN];
uart_info 	g_uart2_info;

#ifdef	INCLUDE_OPPOSITE_COMM
comm_source_info g_uart2_comm_src_info;
#endif

/*****************************************************************************
** Function name:		USART2_IRQHandler
**
** Descriptions:		UART2 interrupt handler
**
** parameters:			None
** Returned value:		None
** 
*****************************************************************************/
void USART2_IRQHandler(void) 
{
	uart_interrupt(UART2_ID, &g_uart2_info);
}

/******************************************************************************************
*uart2_init		--串口初始化函数
*--
*Input:
*	无
*Output:
*	无
*Return:
*	OK/ERROR	表示执行成功与否
*
*/
STATUS uart2_init(void)
{
	uart_config_struct cfg = UART2_CFG_PARA;
	NVIC_InitTypeDef NVIC_InitStructure;  
	memset(&NVIC_InitStructure,0,sizeof(NVIC_InitStructure));
	
	/*调用串口初始化函数设置串口*/
	if(uart_port_init(UART2_ID, &cfg) != OK)
	{
		return ERROR;
	}

	 /* Enable the uart2 Interrupt */
	NVIC_InitStructure.NVIC_IRQChannel = (OTP_UINT8)USART2_IRQn;
	NVIC_InitStructure.NVIC_IRQChannelPreemptionPriority = UART2_Preemption_Priority;
	NVIC_InitStructure.NVIC_IRQChannelSubPriority = UART2_Sub_Priority;
	NVIC_InitStructure.NVIC_IRQChannelCmd = Enable;
	NVIC_Init(&NVIC_InitStructure);
	
	return OK;
}

/******************************************************************************************
*uart2_rs232_init		--串口初始化函数
*--
*Input:
*	prt	--协议类型
*	rcv --信息接收函数
*	opttypercv --光头类型烧写信息接收函数
*Output:
*	无
*Return:
*	OK/ERROR	表示执行成功与否
*
*/
STATUS uart2_rs232_init(uart_protocol_type prt, 
						uart_rcv_func rcv,
						uart_rcv_func opttypercv)
{

	/*清数据结构*/
	memset(&g_uart2_info, 0, sizeof(g_uart2_info));

	/*记录报文处理协议*/
	g_uart2_info.prt = prt;
	/*记录接收报文处理函数*/
	g_uart2_info.rinfo.rproc.rcv = rcv;

#ifdef INCLUDE_OPTTYPE
	g_uart2_info.rinfo.opttype.rcv = opttypercv;
#else
	NO_USE(opttypercv);
#endif

#ifdef INCLUDE_OPPOSITE_COMM
	/*响应消息的发送函数*/
	g_uart2_comm_src_info.send = (xxx_msg_send)uart2_msg_send;
	g_uart2_comm_src_info.comm_obj = comm_to_uart2;
	g_uart2_info.arg = &g_uart2_comm_src_info;
#else
	g_uart2_info.arg = (OTP_VOID *)uart2_msg_send;
#endif

	/*接收和发送指针执行相应的缓冲区*/
	g_uart2_info.rinfo.rproc.pdata = g_uart2_rcv_buf;
	g_uart2_info.rinfo.rproc.datalen = UART2_RCV_BUFLEN;
	g_uart2_info.sinfo.pdata = g_uart2_send_buf;
	g_uart2_info.sinfo.datalen = UART2_SEND_BUFLEN;

	return OK;
}

/*******************************************************************************
*uart2_rcv_process  接收报文处理，按照相应的协议，对接收缓冲区的报文进行处理，并调用
*		注册的rcv处理函数；
*Input:
*	uid		--uart的端口号，范围为0和1，好像没有什么用，考虑去掉
*	prt		--报文处理使用的协议，根据协议类型进行报文接收；
*	prinfo	--接收缓冲区相关信息指针；
*Output:
*	None	
*Return:
*	OK/ERROR，表示执行成功和失败
*/
STATUS uart2_rcv_process(void)
{
	return uart_rcv_process(g_uart2_info.arg, g_uart2_info.prt, &g_uart2_info.rinfo);
}


/*******************************************************************************
*uart2_msg_send 发送报文处理
*Input:
*	psinfo	--发送缓冲区指针，用于存放发送的消息；
*	buf		--需要发送的数据指针
*	buflen	--发送的数据长度
*Output:
*	None	
*Return:
*	OK/ERROR，表示执行成功和失败
*/
STATUS uart2_msg_send(const OTP_UINT8 *buf, OTP_UINT32 buflen)
{
	/*参数检查*/
	if(buf == NULL)
	{
		MCU_EXC_ERROR;
		return ERROR;
	}
	if(buflen == 0)
	{
		MCU_EXC_ERROR;
		return ERROR;
	}
	
	if(uart_msg_send(UART2_ID, &g_uart2_info, buf, buflen) != OK)
	{
		MCU_EXC_ERROR;
		return ERROR;
	}
	
	return OK;
}


#endif

